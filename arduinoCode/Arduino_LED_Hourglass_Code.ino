/*
Zeeshan Atmar 
LED Arduino Hourglass 
06/2026
Project Creator and Inspiration By: Edison-Science-Corner - "LED HOURGLASS USING ARDUINO"

NOTE: 
Required Libraries is downloadable and can be included from what the creator provided...
however, this code avoids using his custom libraries (I am using standard Libraries provided from Arduino)... 
and instead have GEMINI 3.1 PRO to work around the program without the creators libraries. 

Operating System: Windows 11 
IDE Software: Arduino IDE 2.3.10

Hardware Requirements: 
1. Arduino Nano R4 [ABX00142]
2. Two 8x8 LED Matrix's (MAX7219)
3. Analog Accelormeter (ADXL335)
4. Lithium Polymer Ion Battery (3.7 V and 600 mA)
5. Type-C Power Supply Module (2A and 5V)
*/


// --- Library and Pin Set-up ---

// NOTE: This standard library only allows the Arduino to send commands (cannot read and rotate what's on the screen)...
// so we have to build a "virtual screnn" inside the Arduino's RAM
#include "LedControl.h"

const int PIN_DATA_IN = 5; 
const int PIN_CLK = 4; 
const int PIN_LOAD = 6;

const int PIN_ACCEL_X = A1; 
const int PIN_ACCEL_Y = A2;

const int TOP_MATRIX = 1; 
const int BOTTOM_MATRIX = 0;

/*
NOTES:
The ANALOG accelerometer has a "thresehold" of 0-1023 which represents the physical voltage output translated into a digital number...
that a microcontroller can process. This is generated by a 10-bit Analog-to-Digital Converter (ADC). 
When the accelerometer is sitting perfectly flat, it reads a baseline middle voltage of 300
The "sand" will start moving when the Accelerometer measures a value past 360 volts
We need this threshold in the program so Arduino ignores tiny accidental bumps and only reacts to obvious/deliberate tilts
*/
const int ACCEL_LOW_THRESH = 300; 
const int ACCEL_HIGH_THRESH = 360;


// --- System States ---

/* NOTES:
enum means enumeration which is a way to create your own custom data type that consists of a predefined list of named values
In this case: UP = 0 degrees, DOWN = 180 degrees, LEFT = 270 degrees, and RIGHT = 90 degrees
The Arduino complier is quitely assigning an integer to each item in the list starting from zero...
UP = 0, DOWN = 1, LEFT = 2, RIGHT = 3 and by declaring the variable as an Orientation type, the compiler restricts it.
*/
enum Orientation { UP, DOWN, LEFT, RIGHT };
Orientation currentGravity = UP;


// --- Hardware Objects ---

// This creates the object "display" and tells the Arduino exactly which pins are wired to the MAX7219 on the LED matrix
LedControl display = LedControl(PIN_DATA_IN, PIN_CLK, PIN_LOAD, 2); // The 2 at the endns tells the Arduino that their are two LED's daisy-chained together
// These setup up a stopwatch to track time in the background so the "sand" can keep moving while waiting for the next particle to drop
unsigned long lastDropTime = 0;
const unsigned long DROP_INTERVAL_MS = 1000; // 1 second per particle


// --- VIRTUAL MATRIX BUFFER ---

/* NOTE:
Because the hardware chip cannot tell us if an LED is turned on or off, we update this digital blueprint every time we turn an LED on
and then we ask the blueprint if a space is empty during the physics calculation.
*/
// We use this array (grid) to keep track of the LEDs in the Arduino's memory (the digital blueprint)
// The '2' means there are two matrices (Top and Bottom) 
// The two '8' means each matrix has an 8x8 grid of LEDs
// The false means it starts everything completely blank, so no "sand"
bool ledBuffer[2][8][8] = {false};
int currentRotation = 0;

// These functions talk to the physical hardware layout, ignoring rotation
/* NOTES:
int matrixIndex tells the Arduino which display to look at (1 for TOP_MATRIX and 0 for BOTTOM_MATRIX)
int x is the horizontal coordinate of the LED on that specific matrix and int y is the vertical
bool state tells the Arduino what to do with that specific LED (true = turn on meaning there is sand and false = turn off meaning the space is empty)
*/
void setRawXY(int matrixIndex, int x, int y, bool state) {
  // This is a safety guardrail so the physics engine doesn't send a grain of "sand" off the edge of a matrix, so the code doesn't crash
  if (x < 0 || x > 7 || y < 0 || y > 7) return;
  ledBuffer[matrixIndex][x][y] = state; // This updates the digital blueprint in the RAM
  display.setLed(matrixIndex, y, x, state); // This sends standard command to the MAX7219 chip
}

// When the code needs to know if a specific LED is lit it checks the digitial blueprint in RAM and returns true (lit) or false (empty)
// We use the boolean function because an LED can only be on or off (true or false) and the physics engine uses that answer to decide if a "sand grain" can fall into that space/LED
bool getRawXY(int matrixIndex, int x, int y) {
  if (x < 0 || x > 7 || y < 0 || y > 7) return false;
  return ledBuffer[matrixIndex][x][y];
}

// Not absouluetly needed, but these read the current state of the LED and set that LED to the exact opposite state
/* NOTES: 
This coorelates towards the bottle neck section since it's proved that the top LED is on and the bottom LED is off.
The top LED inverts from on to off (sand is leaving) and the bottom LED inverts from off to on (sand is arriving)
Without it, the bottle neck section would have to be explicitly turn off the top and turn on the bottom...
  setRawXY(TOP_MATRIX, 0, 0, false);
  setRawXY(BOTTOM_MATRIX, 7, 7, true);
*/
void invertRawXY(int matrixIndex, int x, int y) {
  setRawXY(matrixIndex, x, y, !getRawXY(matrixIndex, x, y));
}

// These take an X and Y coordinate and applies standard 2D matrix rotation math since the hourglass is tilted 90 degrees [(0,0)->(0,7)]
void getRotatedCoords(int &x, int &y) { // The '&' is called a "Pass-by-Reference" (directly modifies the values by the function changes)
  int tempX = x;
  if (currentRotation == 90) {
    x = y; y = 7 - tempX;
  } else if (currentRotation == 180) {
    x = 7 - x; y = 7 - y;
  } else if (currentRotation == 270) {
    x = 7 - y; y = tempX;
  }
}

// These are for the physics engine
void setXY(int matrixIndex, int x, int y, bool state) {
  int rx = x, ry = y; // This creates "photocopies"
  getRotatedCoords(rx, ry); // This does the rotation math and physically writes the new coordinates 
  setRawXY(matrixIndex, rx, ry, state); // This takes those altered numbers and turns on the light
}

// These are for the physics engine 
bool getXY(int matrixIndex, int x, int y) { // The physics engine is trying to decide if a "grain of sand" can fall in the space (matrix)
  int rx = x, ry = y; // This will save the new physical coordinates into rx and ry after applu=ying the rotation math
  getRotatedCoords(rx, ry); // 
  return getRawXY(matrixIndex, rx, ry); // The compiler forces us to use return for a boolean function to pass a TRUE or FLASE answer 
  // The return command takes that true or flase and shoots it all the way back out of the getXY() function, directly into the hands of they physics engine that originally asked the question 
}

// This helps sets our software rotation
void setRotation(int angle) {
  currentRotation = angle % 360; // The % means modulo which is a math operator that fives you the remainder after division
/* For Example:
360 degrees also equals to 0 degrees
If you somehow passed 450 degrees into this function, the remainder would be 90 degrees
it ensures that the currentRotation variable is always safely locked between 0 and 359, preventing the math from spiraling out of control
*/
}


void setup() {
  // This is optional but this sets a line of serial communication between the Arduino and our Serial Monitor to look at our x and y values chaning 
  Serial.begin(9600);
  // In order to ensure the "sand" will fall at true randomness instead of a pattern, the analogRead(A0) acts as a tiny attena (since nothing is wired to it) and picks up microscopic electromagnetic noise from the room and spit out a random number
  randomSeed(analogRead(A0)); 

  // This for loop  runs exactly twice: once for LED matrix 0 and once for matrix 1 
  for (byte i = 0; i < 2; i++) {
    display.shutdown(i, false); // The MAX7219 chip defaults to a low-power sleep mode to save battery. This command asks if the chip is shutdown and if false it wakes the chip up
    display.setIntensity(i, 4); // This sets the physcial brightness or the intensity of the LED (range 0-15) We do 4 to save on the battery
    display.clearDisplay(i); // This wipes the physical matrix clean so no random data is lit up on boot
  }
  // This instantly sets 60 out of the 64 LEDs on the top matrix to true (on) and filling the top half of the hourglass
  fillTopMatrix(60); 
}

void loop() {
  // This jumps to the sensor function by reading the voltage from the accelerometer and updates the 'currentGravity' variable (UP,DOWN,LEFT, or RIGHT)
  updateOrientation();
  
  // These are to set the current rotation of the device
  int rotationAngle = getRotationAngle(currentGravity); // Converts the word (like 'RIGHT') into a number (like 90)
  // Because the LED matrices are mounted sideways in the shell, adding the 90 degree rotation makes the "sand" fall towards the floor vs the side wall
  setRotation(90 + rotationAngle); // Use our new custom rotation

  // This scans through all 128 virtual LEDs and if a grain of sand has an empty sapce below it, it moves it down one pixel
  calculateSandPhysics();
  // This checks is 1 second has passed. If yes, it moves one grain from the top to the bottom physical matrix
  attemptParticleDrop();

  // This is the speed the sand falls and we need this since Arduino runs at roughly 16 million instructions per second
  delay(100); // 100 ms
}

// --- SENSOR POLLING ---

// These read the raw electrical signals from the accelerometer and decides which of the four directions is currently "down"
void updateOrientation() {
  // For both X and Y axis, the arduino reads the voltage coming from the accelerometer and translates the voltage into a raw number betwen 90-1023)
  int xValue = analogRead(PIN_ACCEL_X); 
  int yValue = analogRead(PIN_ACCEL_Y);

  if (yValue < ACCEL_LOW_THRESH)       
  currentGravity = UP;
  else if (xValue > ACCEL_HIGH_THRESH) 
  currentGravity = RIGHT;
  else if (yValue > ACCEL_HIGH_THRESH) 
  currentGravity = DOWN;
  else if (xValue < ACCEL_LOW_THRESH)  
  currentGravity = LEFT;
}

int getRotationAngle(Orientation grav) {
  switch(grav) {
    case UP: return 0;
    case RIGHT: return 90;
    case DOWN: return 180;
    case LEFT: return 270;
  }
  return 0;
}

// --- PHYSICS ENGINE ---

void calculateSandPhysics() {
  for (byte slice = 0; slice < 15; ++slice) {
    bool randomSlideDirection = (random(2) == 1);
    byte start = (slice < 8) ? 0 : slice - 7;
    
    for (byte j = start; j <= slice - start; ++j) {
      byte y = randomSlideDirection ? (7 - j) : (7 - (slice - j));
      byte x = randomSlideDirection ? (slice - j) : j;
      
      processParticleMovement(BOTTOM_MATRIX, x, y);
      processParticleMovement(TOP_MATRIX, x, y);
    }
  }
}

bool processParticleMovement(int matrixIndex, int x, int y) {
  if (!getXY(matrixIndex, x, y)) return false; 

  bool canGoDown = (y < 7 && !getXY(matrixIndex, x - 1, y + 1));
  bool canGoLeft = (x > 0 && !getXY(matrixIndex, x - 1, y));
  bool canGoRight = (y < 7 && !getXY(matrixIndex, x, y + 1));

  if (canGoDown) {
    movePixel(matrixIndex, x, y, x - 1, y + 1);
  } else if (canGoLeft && !canGoRight) {
    movePixel(matrixIndex, x, y, x - 1, y);
  } else if (canGoRight && !canGoLeft) {
    movePixel(matrixIndex, x, y, x, y + 1);
  } else if (canGoLeft && canGoRight) {
    (random(2) == 1) ? movePixel(matrixIndex, x, y, x - 1, y) : movePixel(matrixIndex, x, y, x, y + 1);
  } else {
    return false; 
  }
  return true;
}

void movePixel(int matrixIndex, int oldX, int oldY, int newX, int newY) {
  setXY(matrixIndex, oldX, oldY, false);
  setXY(matrixIndex, newX, newY, true);
}

// --- BOTTLENECK (INTER-MATRIX TRANSFER) ---

bool attemptParticleDrop() {
  if (millis() - lastDropTime >= DROP_INTERVAL_MS) {
    lastDropTime = millis();
    
    if (currentGravity == UP || currentGravity == DOWN) {
      // This checks if the sand is at the top hole and the bottom hole is emtpy
      if (getRawXY(TOP_MATRIX, 0, 0) && !getRawXY(BOTTOM_MATRIX, 7, 7)) {
        
        invertRawXY(TOP_MATRIX, 0, 0); // This flicks the top switch      
        invertRawXY(BOTTOM_MATRIX, 7, 7); // This flicks the bottom switch
        return true;
      }
    }
  }
  return false;
}

// --- UTILITY FUNCTIONS ---

void fillTopMatrix(int maxCount) {
  int count = 0;
  for (byte y = 0; y < 8; y++) {
    for (byte x = 0; x < 8; x++) {
      if (count < maxCount) {
        setRawXY(TOP_MATRIX, x, y, true);
        count++;
      }
    }
  }
}
